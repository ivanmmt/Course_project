/* =============================================================================
 * userspace/userspace.ld — линкер скрипт для пользовательских программ
 *
 * Программы загружаются по адресу 0x400000 (4 МБ)
 * Это стандартный базовый адрес для 32-битных Linux ELF программ.
 *
 * Почему 0x400000:
 *   - Ядро занимает с 0x100000 (1 МБ)
 *   - Между 0x100000 и 0x400000 — стеки, heap ядра
 *   - С 0x400000 начинается "пользовательское" пространство
 *   - VMM будет маппировать страницы по нужным адресам
 * ============================================================================= */

ENTRY(main)

SECTIONS {
    . = 0x400000;

    .text : {
        *(.text .text.*)
    }

    .rodata ALIGN(4K) : {
        *(.rodata .rodata.*)
    }

    .data ALIGN(4K) : {
        *(.data .data.*)
    }

    .bss ALIGN(4K) : {
        *(COMMON)
        *(.bss .bss.*)
    }

    /DISCARD/ : {
        *(.comment)
        *(.note.*)
        *(.eh_frame*)
        *(.dynamic)
        *(.got*)
        *(.plt*)
        *(.rel*)
    }
}
